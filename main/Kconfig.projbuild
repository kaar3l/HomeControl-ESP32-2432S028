## main/Kconfig.projbuild
```kconfig
menu "Display Configuration"

    choice DISPLAY_TYPE
        prompt "Display controller"
        default DISPLAY_TYPE_ILI9341
        help
            Select the TFT controller fitted on your board.
            ESP32-2432S028  (v1 / v2) : ILI9341
            ESP32-2432S028S (v3 / S)  : ST7789

        config DISPLAY_TYPE_ILI9341
            bool "ILI9341  (2432S028 v1/v2)"

        config DISPLAY_TYPE_ST7789
            bool "ST7789   (2432S028S / v3)"

    endchoice

endmenu
```

## sdkconfig.defaults
```kconfig
# Partition table
CONFIG_PARTITION_TABLE_CUSTOM=y
CONFIG_PARTITION_TABLE_CUSTOM_FILENAME="partitions.csv"

# Flash size
CONFIG_ESPTOOLPY_FLASHSIZE_4MB=y

# WiFi
CONFIG_ESP_WIFI_STATIC_RX_BUFFER_NUM=10
CONFIG_ESP_WIFI_DYNAMIC_RX_BUFFER_NUM=32

# LWIP
CONFIG_LWIP_MAX_SOCKETS=16

# HTTP server
CONFIG_HTTPD_MAX_REQ_HDR_LEN=1024
CONFIG_HTTPD_MAX_URI_LEN=512

# HTTPS OTA
CONFIG_OTA_ALLOW_HTTP=y

# FreeRTOS tick rate (needed for LVGL ms timing)
CONFIG_FREERTOS_HZ=1000

# SPI DMA
CONFIG_SPI_MASTER_IN_IRAM=y

# LVGL — configured via idf_component.yml overrides
# Stack sizes
CONFIG_ESP_MAIN_TASK_STACK_SIZE=8192

# NVS
CONFIG_NVS_ENCRYPTION=n
```
